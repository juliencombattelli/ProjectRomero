## RaspberryPi/yocto/build/conf/bblayers.conf
```bitbake
# POKY_BBLAYERS_CONF_VERSION is increased each time build/conf/bblayers.conf
# changes incompatibly
POKY_BBLAYERS_CONF_VERSION = "2"

BBPATH = "${TOPDIR}"
BBFILES ?= ""

BBLAYERS ?= " \
  /home/jucom/Development/yocto/rocko/src/poky/meta \
  /home/jucom/Development/yocto/rocko/src/poky/meta-poky \
  /home/jucom/Development/yocto/rocko/src/poky/meta-yocto-bsp \
  /home/jucom/Development/yocto/rocko/src/meta-openembedded/meta-oe \
  /home/jucom/Development/yocto/rocko/src/meta-openembedded/meta-python \
  /home/jucom/Development/yocto/rocko/src/meta-mingw \
  /home/jucom/Development/yocto/rocko/src/meta-raspberrypi \
  /home/jucom/Development/yocto/rocko/src/meta-acm \
  "
```

## RaspberryPi/yocto/src/meta-acm/conf/distro/acm.conf
```bitbake
require conf/distro/poky.conf

DISTRO = "acm"
DISTRO_NAME = "ACM Distribution"
DISTRO_VERSION = "1.0-${DATE}"
DISTRO_CODENAME = "acmdist"
DISTRO_FEATURES_append = " bluez5 wifi bluetooth systemd ipv6 usbhost"
SDK_VENDOR = "-acmsdk"
SDK_VERSION = "${DISTRO_VERSION}"
MAINTAINER = "Romero team <julien.combattelli@gmail.com>"

# Enable buildhistory
INHERIT += "buildhistory"
BUILDHISTORY_COMMIT = "1" 

# Enable systemd
VIRTUAL-RUNTIME_init_manager = "systemd"
DISTRO_FEATURES_BACKFILL_CONSIDERED = "sysvinit"
VIRTUAL-RUNTIME_initscripts = ""

# Set U-boot as bootloader
KERNEL_IMAGETYPE = "uImage"
IMAGE_DEPENDS_sdimg += " bcm2835-bootfiles"
IMAGE_BOOT_FILES_append = " boot.scr u-boot.bin;${SDIMG_KERNELIMAGE}"
IMAGE_INSTALL_append = " kernel-image kernel-devicetree"

ENABLE_SPI_BUS = "1"
ENABLE_UART = "1"
ENABLE_CAN = "1"
VIDEO_CAMERA = "1"

GPU_MEM = "16"

RPI_USE_U_BOOT = "1"

hostname_pn-base-files = "romero"

KERNEL_MODULE_AUTOLOAD_append = " mcp251x bcm2835-v4l2 "

KERNEL_DEVICETREE = " \
    bcm2708-rpi-0-w.dtb \
    bcm2708-rpi-b.dtb \
    bcm2708-rpi-b-plus.dtb \
    bcm2709-rpi-2-b.dtb \
    bcm2710-rpi-3-b.dtb \
    bcm2708-rpi-cm.dtb \
    bcm2710-rpi-cm3.dtb \
    \
    overlays/hifiberry-amp.dtbo \
    overlays/hifiberry-dac.dtbo \
    overlays/hifiberry-dacplus.dtbo \
    overlays/hifiberry-digi.dtbo \
    overlays/i2c-rtc.dtbo \
    overlays/iqaudio-dac.dtbo \
    overlays/iqaudio-dacplus.dtbo \
    overlays/lirc-rpi.dtbo \
    overlays/pitft22.dtbo \
    overlays/pitft28-resistive.dtbo \
    overlays/pitft35-resistive.dtbo \
    overlays/pps-gpio.dtbo \
    overlays/rpi-ft5406.dtbo \
    overlays/w1-gpio.dtbo \
    overlays/w1-gpio-pullup.dtbo \
    overlays/pi3-disable-bt.dtbo \
    overlays/pi3-miniuart-bt.dtbo \
    overlays/vc4-kms-v3d.dtbo \
    overlays/mcp2515-can0.dtbo \
"
```

## RaspberryPi/yocto/src/meta-acm/conf/layer.conf
```bitbake
# We have a conf and classes directory, append to BBPATH
BBPATH .= ":${LAYERDIR}"

# We have a recipes directory containing .bb and .bbappend files, add to BBFILES
BBFILES += "${LAYERDIR}/recipes*/*/*.bb \
            ${LAYERDIR}/recipes*/*/*.bbappend"

BBFILE_COLLECTIONS += "acm"
BBFILE_PATTERN_acm := "^${LAYERDIR}/"
BBFILE_PRIORITY_acm = "9"
```
